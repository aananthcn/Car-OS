AUTOSAR XML (schema 4-0-3)
package /Ecuc_RaspberryPi-Pico
  module config Mcu: ecuc-def-edition=4.2.0, implementation-config-variant=VARIANT-PRE-COMPILE
    McuNammaAutosarInfo (VendorSpecific): Micro=rp2040, MicroArch=cortex-m0, MicroMaker=RaspberryPi
  module config Port: ecuc-def-edition=4.2.0, implementation-config-variant=VARIANT-PRE-COMPILE
    PortConfigSet
      PortContainer: PortNumberOfPortPins=14
        14 x PortPin, all with PortPinDirectionChangeable=FALSE, PortPinModeChangeable=FALSE:
          PortPin: PortPinId=4, PortPinDirection=PORT_PIN_OUT, PortPinLevelValue=PORT_PIN_LEVEL_LOW, PortPinMode=PORT_PIN_MODE_LIN, PortPinInitialMode=PORT_PIN_MODE_LIN
          PortPin: PortPinId=5, PortPinDirection=PORT_PIN_IN, PortPinLevelValue=PORT_PIN_LEVEL_LOW, PortPinMode=PORT_PIN_MODE_LIN, PortPinInitialMode=PORT_PIN_MODE_LIN
          PortPin: PortPinId=25, PortPinDirection=PORT_PIN_OUT, PortPinLevelValue=PORT_PIN_LEVEL_LOW, PortPinMode=PORT_PIN_MODE_DIO, PortPinInitialMode=PORT_PIN_MODE_DIO
          PortPin: PortPinId=0, PortPinDirection=PORT_PIN_IN, PortPinLevelValue=PORT_PIN_LEVEL_LOW, PortPinMode=PORT_PIN_MODE_SPI, PortPinInitialMode=PORT_PIN_MODE_SPI
          PortPin: PortPinId=1, PortPinDirection=PORT_PIN_OUT, PortPinLevelValue=PORT_PIN_LEVEL_HIGH, PortPinMode=PORT_PIN_MODE_DIO, PortPinInitialMode=PORT_PIN_MODE_DIO
          PortPin: PortPinId=2, PortPinDirection=PORT_PIN_OUT, PortPinLevelValue=PORT_PIN_LEVEL_LOW, PortPinMode=PORT_PIN_MODE_SPI, PortPinInitialMode=PORT_PIN_MODE_SPI
          PortPin: PortPinId=3, PortPinDirection=PORT_PIN_OUT, PortPinLevelValue=PORT_PIN_LEVEL_LOW, PortPinMode=PORT_PIN_MODE_SPI, PortPinInitialMode=PORT_PIN_MODE_SPI
          PortPin: PortPinId={16..19}, PortPinDirection=PORT_PIN_OUT, PortPinLevelValue=PORT_PIN_LEVEL_HIGH, PortPinMode=PORT_PIN_MODE_DIO, PortPinInitialMode=PORT_PIN_MODE_DIO
          PortPin: PortPinId={20..22}, PortPinDirection=PORT_PIN_IN, PortPinLevelValue=PORT_PIN_LEVEL_HIGH, PortPinMode=PORT_PIN_MODE_DIO, PortPinInitialMode=PORT_PIN_MODE_DIO
    PortGeneral: PortDevErrorDetect=TRUE, PortVersionInfoApi=FALSE, PortSetPinDirectionApi=TRUE, PortSetPinModeApi=FALSE
  module config Dio: ecuc-def-edition=4.2.0, implementation-config-variant=VARIANT-PRE-COMPILE
    DioConfig
      DioPort: DioPortId=25
        DioChannel: DioChannelId=25
      DioPort: DioPortId=1
        DioChannel: DioChannelId=1
    DioGeneral: DioDevErrorDetect=FALSE, DioVersionInfoApi=TRUE, DioFlipChannelApi=FALSE, DioMaskedWritePortApi=TRUE
  module config Spi: ecuc-def-edition=4.2.0, implementation-config-variant=VARIANT-PRE-COMPILE
    SpiDriver: SpiMaxChannel=1, SpiMaxJob=1, SpiMaxSequence=1
      SpiChannel: SpiChannelId=0, SpiChannelType=EB (External Buffer), SpiDataWidth=8, SpiDefaultData=0x0, SpiEbMaxLength=2048, SpiIbNBuffers=0, SpiTransferStart=MSB
      SpiExternalDevice:
        SpiBaudrate = 8000000.0
        SpiCsIdentifier = CS_Ethernet
        SpiCsPolarity = LOW
        SpiCsSelection = CS_VIA_GPIO
        SpiDataShiftEdge = LEADING
        SpiEnableCs = FALSE
        SpiHwUnit = spi0
        SpiShiftClockIdleLevel = LOW
        SpiTimeClk2Cs = 0.0
        SpiTimeCs2Clk = 0.000001
        SpiTimeCs2Cs = 0.000001
        DIO = 1
        SpiFrameFormat = MOTOROLA_SPI
      SpiJob: SpiJobEndNotification=NULL, SpiJobId=0, SpiJobPriority=0, SpiDeviceAssignment=spi0
        SpiChannelList: SpiChannelIndex=0, SpiChannelAssignment=Job no: 0
      SpiSequence: SpiInterruptibleSequence=FALSE, SpiSeqEndNotification=NULL, SpiSequenceId=0, SpiSequenceName=SEQ_ETHERNET_BASIC_TX_RX
        SpiJobAssignment: SpiJob=0
    SpiGeneral:
      SpiCancelApi = FALSE
      SpiChannelBuffersAllowed = IB
      SpiDevErrorDetect = FALSE
      SpiHwStatusApi = FALSE
      SpiInterruptibleSeqAllowed = FALSE
      SpiLevelDelivered = 1
      SpiMainFunctionPeriod = 0.01
      SpiSupportConcurrentSyncTransmit = FALSE
      SpiVersionInfoApi = FALSE
    SpiPublishedInformation: SpiMaxHwUnit=1
  module config Lin: ecuc-def-edition=4.2.0, implementation-config-variant=VARIANT-PRE-COMPILE
    LinGeneral: LinIndex=0, LinDevErrorDetect=FALSE, LinVersionInfoApi=FALSE, LinTimeoutDuration=2
    LinGlobalConfig
      LinChannel: LinChannelId=0, LinNodeType=SLAVE, LinChannelBaudRate=1000, LinChannelWakeupSupport=FALSE, LinChannelEcuMWakeupSource=test, LinClockRef=test
  module config Lin: ecuc-def-edition=4.2.0, implementation-config-variant=VARIANT-PRE-COMPILE
    LinGeneral: LinIndex=1, LinDevErrorDetect=TRUE, LinVersionInfoApi=TRUE, LinTimeoutDuration=0
    LinGlobalConfig
      LinChannel: LinChannelId=1, LinNodeType=MASTER, LinChannelBaudRate=1000, LinChannelWakeupSupport=FALSE, LinChannelEcuMWakeupSource=chumma, LinClockRef=chumma
  module config EthIf: ecuc-def-edition=4.2.0, implementation-config-variant=VARIANT-PRE-COMPILE
    EthIfConfigSet
      EthIfFrameOwnerConfig: EthIfFrameType=0x0000, EthIfOwner=0x00
      EthIfFrameOwnerConfig: EthIfFrameType=0x0001, EthIfOwner=0x01
      EthIfRxIndicationConfig: EthIfRxIndicationFunction=NULL
      EthIfRxIndicationConfig: EthIfRxIndicationFunction=NULL
      EthIfTxConfirmationConfig: EthIfTxConfirmationFunction=NULL
      EthIfTxConfirmationConfig: EthIfTxConfirmationFunction=NULL
      EthIfTrcvLinkStateChgConfig: EthIfTrcvLinkStateChgFunction=NULL
      EthIfTrcvLinkStateChgConfig: EthIfTrcvLinkStateChgFunction=NULL
      EthIfPhysController: EthIfPhysControllerIdx=0, EthIfEthCtrlRef=..., EthIfWEthCtrlRef=...
        EthIfPhysCtrlRxMainFunctionPriorityProcessing: EthIfPhysCtrlRxMainFunctionPeriod=0.1, EthIfPhysCtrlRxIndicationIterations=0, EthIfPhysCtrlRxIngressFifoRef=...
      EthIfPhysController: EthIfPhysControllerIdx=1, EthIfEthCtrlRef=..., EthIfWEthCtrlRef=...
        EthIfPhysCtrlRxMainFunctionPriorityProcessing: EthIfPhysCtrlRxMainFunctionPeriod=0.1, EthIfPhysCtrlRxIndicationIterations=0, EthIfPhysCtrlRxIngressFifoRef=...
      EthIfController:
        EthIfCtrlIdx = 0
        EthIfVlanId = 0
        EthIfCtrlMtu = 64
        EthIfMaxTxBufsTotal = 1
        EthIfPhysControllerRef = ...
        EthIfEthTrcvRef = ...
        EthIfSwitchRef = ...
        EthIfSwitchPortGroupRef = ...
      EthIfTransceiver: EthIfTransceiverIdx=0, EthIfEthTrcvRef=..., EthIfWEthTrcvRef=...
      EthIfSwitch: EthIfSwitchIdx=0, EthIfSwitchRef=...
      EthIfSwitchPortGroup: EthIfSwitchPortGroupIdx=0, EthIfSwitchPortGroupRefSemantics=ETHIF_SWITCH_PORT_GROUP_LINK_INFO, EthIfPortRef=...
    EthIfGeneral:
      EthIfMaxTrcvsTotal = 2
      EthIfDevErrorDetect = TRUE
      EthIfEnableRxInterrupt = FALSE
      EthIfEnableTxInterrupt = FALSE
      EthIfVersionInfoApi = FALSE
      EthIfVersionInfoApiMacro = FALSE
      EthIfTrcvLinkStateChgMainReload = 1
      EthIfMainFunctionPeriod = 0.01
      EthIfPublicCddHeaderFile = baba1.h
      EthIfPublicCddHeaderFile = baba2.h
      EthIfRxIndicationIterations = 0
      EthIfGetAndResetMeasurementDataApi = FALSE
      EthIfStartAutoNegotiation = TRUE
      EthIfGetBaudRate = FALSE
      EthIfGetCounterState = FALSE
      EthIfGlobalTimeSupport = FALSE
      EthIfWakeUpSupport = TRUE
      EthIfGetTransceiverWakeupModeApi = FALSE
      EthIfSwitchOffPortTimeDelay = 0.01
      EthIfPortStartupActiveTime = 0.01
      EthIfMainFunctionStatePeriod = 0.01
      EthIfSetForwardingModeApi = FALSE
      EthIfVerifyConfigApi = FALSE
      EthIfSwitchManagementSupport = FALSE
      EthIfGetCtrlIdxList = FALSE
      EthIfGetVlanIdSupport = FALSE
      EthIfEnableWEthApi = FALSE
      EthIfEnableSignalQualityApi = FALSE
      EthIfSignalQualityCheckPeriod = 0.01
      EthIfEnableSecurityEventReporting = FALSE
      EthIfSecurityEventRefs = ...
  module config SoAd: ecuc-def-edition=4.2.0, implementation-config-variant=VARIANT-PRE-COMPILE
    SoAdGeneral:
      SoAdDevErrorDetect = TRUE
      SoAdVersionInfoApi = TRUE
      SoAdIPv6AddressEnabled = TRUE
      SoAdMainFunctionPeriod = 0.02
      SoAdSoConMax = 38
      SoAdRoutingGroupMax = 4
      SoAdGetAndResetMeasurementDataApi = TRUE
      SoAdEnableSecurityEventReporting = TRUE
      SoAdSecurityEventRefs = ...
    SoAdBswModules:
      SoAdIf = FALSE
      SoAdIfTriggerTransmit = FALSE
      SoAdIfTxConfirmation = FALSE
      SoAdLocalIpAddrAssigmentChg = FALSE
      SoAdSoConModeChg = FALSE
      SoAdTp = FALSE
      SoAdUseCallerInfix = FALSE
      SoAdUseTypeInfix = FALSE
      SoAdBswModuleRef = ...
    SoAdBswModules:
      SoAdIf = TRUE
      SoAdIfTriggerTransmit = FALSE
      SoAdIfTxConfirmation = TRUE
      SoAdLocalIpAddrAssigmentChg = FALSE
      SoAdSoConModeChg = TRUE
      SoAdTp = FALSE
      SoAdUseCallerInfix = TRUE
      SoAdUseTypeInfix = FALSE
      SoAdBswModuleRef = Ref2
    SoAdConfig
      SoAdPduRoute: SoAdTxPduId=0, SoAdTxUpperLayerType=IF, SoAdTxPduCollectionSemantics=SOAD_COLLECT_LAST_IS_BEST, SoAdTxPduRef=...
        3 x SoAdPduRouteDest, all with SoAdTxUdpTriggerMode=TRIGGER_ALWAYS, SoAdTxSocketConnOrSocketConnBundleRef=..., SoAdTxRoutingGroupRef=...:
          SoAdPduRouteDest: SoAdTxPduHeaderId=0, SoAdTxUdpTriggerTimeout=10
          SoAdPduRouteDest: SoAdTxPduHeaderId=1, SoAdTxUdpTriggerTimeout=20
          SoAdPduRouteDest: SoAdTxPduHeaderId=2, SoAdTxUdpTriggerTimeout=30
      SoAdRoutingGroup: SoAdRoutingGroupId=0, SoAdRoutingGroupIsEnabledAtInit=FALSE, SoAdRoutingGroupTxTriggerable=FALSE
      SoAdRoutingGroup: SoAdRoutingGroupId=1, SoAdRoutingGroupIsEnabledAtInit=TRUE, SoAdRoutingGroupTxTriggerable=TRUE
      SoAdSocketConnectionGroup:
        SoAdPduHeaderEnable = FALSE
        SoAdSocketPathMTUEnable = FALSE
        SoAdSocketAutomaticSoConSetup = FALSE
        SoAdSocketIpAddrAssignmentChgNotification = FALSE
        SoAdSocketLocalPort = 1
        SoAdSocketSoConModeChgBswMNotification = FALSE
        SoAdSocketSoConModeChgNotification = FALSE
        SoAdSocketTpRxBufferMin = 2
        SoAdSocketFramePriority = 3
        SoAdSocketMsgAcceptanceFilterEnabled = FALSE
        SoAdSocketFlowLabel = 4
        SoAdSocketDifferentiatedServicesField = 5
        SoAdSocketLocalAddressRef = ...
        SoAdSocketSoConModeChgNotifUpperLayerRef = ...
        SoAdSocketProtocol
          SoAdSocketTcp:
            SoAdSocketTcpRetransmissionTimeout = 0.001
            SoAdSocketTcpAutoConnectTimeout = 1
            SoAdSocketTcpInitiate = FALSE
            SoAdSocketTcpNoDelay = FALSE
            SoAdSocketTcpImmediateTpTxConfirmation = FALSE
            SoAdSocketTcpTxQuota = 2
            SoAdSocketTcpKeepAlive = FALSE
            SoAdSocketTcpKeepAliveProbesMax = 3
            SoAdSocketTcpKeepAliveInterval = 4
            SoAdSocketTcpKeepAliveTime = 7200
            SoAdSocketTCPOptionFilterRef = ...
            SoAdSocketTcpTlsConnectionRef = ...
        3 x SoAdSocketConnection:
          SoAdSocketConnection: SoAdSocketId=0
            SoAdSocketRemoteAddress: SoAdSocketRemotePort=123, SoAdSocketRemoteIpAddress=aa
          SoAdSocketConnection: SoAdSocketId=1
            SoAdSocketRemoteAddress: SoAdSocketRemotePort=124, SoAdSocketRemoteIpAddress=bb
          SoAdSocketConnection: SoAdSocketId=2
            SoAdSocketRemoteAddress: SoAdSocketRemotePort=125, SoAdSocketRemoteIpAddress=cc
      SoAdSocketConnectionGroup:
        SoAdPduHeaderEnable = FALSE
        SoAdSocketPathMTUEnable = FALSE
        SoAdSocketAutomaticSoConSetup = FALSE
        SoAdSocketIpAddrAssignmentChgNotification = FALSE
        SoAdSocketLocalPort = 0
        SoAdSocketSoConModeChgBswMNotification = FALSE
        SoAdSocketSoConModeChgNotification = FALSE
        SoAdSocketTpRxBufferMin = 0
        SoAdSocketFramePriority = 0
        SoAdSocketMsgAcceptanceFilterEnabled = FALSE
        SoAdSocketFlowLabel = 0
        SoAdSocketDifferentiatedServicesField = 0
        SoAdSocketLocalAddressRef = ...
        SoAdSocketSoConModeChgNotifUpperLayerRef = ...
        SoAdSocketProtocol
          SoAdSocketUdp:
            SoAdSocketUdpListenOnly = FALSE
            SoAdSocketUdpAliveSupervisionTimeout = 0
            SoAdSocketnPduUdpTxBufferMin = 0
            SoAdSocketUdpTriggerTimeout = 0
            SoAdSocketUdpStrictHeaderLenCheckEnabled = FALSE
            SoAdSocketUdpChecksumEnabled = TRUE
      4 x SoAdSocketRoute, all with SoAdRxSocketConnOrSocketConnBundleRef=...:
        SoAdSocketRoute: SoAdRxPduHeaderId=0
          SoAdSocketRouteDest: SoAdRxPduId=100, SoAdRxUpperLayerType=IF, SoAdRxPduRef=..., SoAdRxRoutingGroupRef=...
        SoAdSocketRoute: SoAdRxPduHeaderId=1
          SoAdSocketRouteDest: SoAdRxPduId=20, SoAdRxUpperLayerType=TP, SoAdRxPduRef=..., SoAdRxRoutingGroupRef=...
        SoAdSocketRoute: SoAdRxPduHeaderId=2
          SoAdSocketRouteDest: SoAdRxPduId=40, SoAdRxUpperLayerType=IF, SoAdRxPduRef=..., SoAdRxRoutingGroupRef=...
        SoAdSocketRoute: SoAdRxPduHeaderId=3
          SoAdSocketRouteDest: SoAdRxPduId=60, SoAdRxUpperLayerType=IF, SoAdRxPduRef=..., SoAdRxRoutingGroupRef=...
  module config Os: ecuc-def-edition=4.2.0, implementation-config-variant=VARIANT-PRE-COMPILE
    3 x OsAppMode:
      OSDEFAULTAPPMODE
      MANUFACT_MODE
      HW_TEST_MODE
    OsOs (OsOS): OsStatus=STANDARD
      OsHooks: OsErrorHook=FALSE, OsPostTaskHook=FALSE, OsPreTaskHook=FALSE, OsShutdownHook=FALSE, OsStartupHook=FALSE, OsProtectionHook=NOT YET SUPPORTED
      OsHookStack: OsHookStackSize=512
      NammaOsekParams (VendorSpecific): OsName=NammaAutosar, CpuName=rp2040, IrqStackSize=512, ContextSaveSize=128, AppTasksSize=5376
    event1 (OsEvent)
    event2 (OsEvent)
    mSecCounter (OsCounter): OsCounterMaxAllowedValue=1000000, OsCounterMinCycle=1, OsCounterTicksPerBase=1, OsCounterType=HARDWARE
    uSecCounter (OsCounter): OsCounterMaxAllowedValue=1000, OsCounterMinCycle=100, OsCounterTicksPerBase=1, OsCounterType=HARDWARE
    RES_MUTEX1 (OsResource): OsResourceProperty=STANDARD
    6 x OsTask, all with OsTaskActivation=1, OsTaskSchedule=NON:
      Task_A: OsTaskPriority=1, OsTaskStackSize=512, OsTaskResourceRef=RES_MUTEX1
        OsTaskAutostart: OsTaskAppModeRef=OSDEFAULTAPPMODE, OsTaskAppModeRef=MANUFACT_MODE, OsTaskAppModeRef=HW_TEST_MODE
      Task_B: OsTaskPriority=2, OsTaskStackSize=512, OsTaskEventRef=event1
        OsTaskAutostart: OsTaskAppModeRef=OSDEFAULTAPPMODE
      Task_C: OsTaskPriority=3, OsTaskStackSize=512, OsTaskEventRef=event1, OsTaskEventRef=event2
        OsTaskAutostart: OsTaskAppModeRef=OSDEFAULTAPPMODE
      Task_D: OsTaskPriority=4, OsTaskStackSize=512, OsTaskResourceRef=RES_MUTEX1
        OsTaskAutostart: OsTaskAppModeRef=OSDEFAULTAPPMODE
      EcuM_StartupTwo: OsTaskPriority=5, OsTaskStackSize=512
        OsTaskAutostart: OsTaskAppModeRef=OSDEFAULTAPPMODE, OsTaskAppModeRef=MANUFACT_MODE, OsTaskAppModeRef=HW_TEST_MODE
      Ethernet_Tasks: OsTaskPriority=0, OsTaskStackSize=2048
        OsTaskAutostart: OsTaskAppModeRef=OSDEFAULTAPPMODE, OsTaskAppModeRef=MANUFACT_MODE, OsTaskAppModeRef=HW_TEST_MODE
    5 x OsAlarm:
      WakeTaskA: OsAlarmCounterRef=mSecCounter
        OsAlarmAction
          ACTIVATETASK (OsAlarmActivateTask): OsAlarmActivateTaskRef=Task_A
        OsAlarmAutostart:
          OsAlarmAlarmTime = 40
          OsAlarmCycleTime = 500
          OsAlarmAutostartType = NOT YET SUPPORTED
          OsAlarmAppModeRef = OSDEFAULTAPPMODE
          OsAlarmAppModeRef = MANUFACT_MODE
      WakeTaskB: OsAlarmCounterRef=mSecCounter
        OsAlarmAction
          SETEVENT (OsAlarmSetEvent): OsAlarmSetEventTaskRef=Task_B, OsAlarmSetEventRef=event1
      uSecAlarm: OsAlarmCounterRef=uSecCounter
        OsAlarmAction
          ALARMCALLBACK (OsAlarmCallback): OsAlarmCallbackName=Alarm_uSecAlarm_callback
      WakeTaskD: OsAlarmCounterRef=mSecCounter
        OsAlarmAction
          ACTIVATETASK (OsAlarmActivateTask): OsAlarmActivateTaskRef=Task_D
        OsAlarmAutostart: OsAlarmAlarmTime=40, OsAlarmCycleTime=1000, OsAlarmAutostartType=NOT YET SUPPORTED, OsAlarmAppModeRef=OSDEFAULTAPPMODE
      ALARM_Ethernet: OsAlarmCounterRef=mSecCounter
        OsAlarmAction
          ACTIVATETASK (OsAlarmActivateTask): OsAlarmActivateTaskRef=Ethernet_Tasks
        OsAlarmAutostart:
          OsAlarmAlarmTime = 500
          OsAlarmCycleTime = 100
          OsAlarmAutostartType = NOT YET SUPPORTED
          OsAlarmAppModeRef = OSDEFAULTAPPMODE
          OsAlarmAppModeRef = MANUFACT_MODE
          OsAlarmAppModeRef = HW_TEST_MODE
    SystemTickISR (OsIsr): OsIsrInterruptNumber=4, OsIsrInterruptPriority=0, OsIsrCategory=2, OsIsrStackSize=
  module config Eth: ecuc-def-edition=4.2.0, implementation-config-variant=VARIANT-PRE-COMPILE
    EthConfigSet
      EthCtrlConfig:
        EthCtrlConfigSwBufferHandling = FALSE
        EthCtrlEnableMii = TRUE
        EthCtrlEnableRxInterrupt = FALSE
        EthCtrlEnableSpiInterface = TRUE
        EthCtrlEnableTxInterrupt = FALSE
        EthCtrlIdx = 0
        EthCtrlMacLayerSpeed = ETH_MAC_LAYER_SPEED_10M
        EthCtrlMacLayerType = ETH_MAC_LAYER_TYPE_XMII
        EthCtrlMacLayerSubType = STANDARD
        EthCtrlPhyAddress = 00:7D:FA:BA:BA:00
        EthSpiCtrlDevice = ENC28J60
        EthCtrlConfigEgress
          EthCtrlConfigEgressFifo:
            EthCtrlConfigEgressFifoBufLenByte = 128
            EthCtrlConfigEgressFifoBufTotal = 100
            EthCtrlConfigEgressFifoIdx = 0
            EthCtrlConfigEgressFifoPriorityAssignment = 7
          EthCtrlConfigScheduler
            EthCtrlConfigSchedulerPredecessor: EthCtrlConfigSchedulerPredecessorOrder=0
          EthCtrlConfigShaper: EthCtrlConfigShaperIdleSlope=1, EthCtrlConfigShaperMaxCredit=1, EthCtrlConfigShaperMinCredit=1
        EthCtrlConfigIngress
          EthCtrlConfigIngressFifo:
            EthCtrlConfigIngressFifoBufLenByte = 128
            EthCtrlConfigIngressFifoBufTotal = 100
            EthCtrlConfigIngressFifoIdx = 0
            EthCtrlConfigIngressFifoPriorityAssignment = 7
        EthCtrlConfigSpiConfiguration:
          EthCtrlConfigSpiChunkPayloadSize = 64
          EthCtrlConfigSpiCommRetries = 1
          EthCtrlConfigSpiCommTimeout = 0.1
          EthCtrlConfigSpiEnableControlDataProtection = FALSE
          EthCtrlConfigSpiEnableRxCSAlign = FALSE
          EthCtrlConfigSpiEnableRxCutThrough = FALSE
          EthCtrlConfigSpiEnableRxZeroAlign = FALSE
          EthCtrlConfigSpiEnableTransmitDataHdrSequence = FALSE
          EthCtrlConfigSpiEnableTxChecksum = FALSE
          EthCtrlConfigSpiEnableTxCutThrough = FALSE
          EthCtrlConfigSpiSelectTimeStamp = FALSE
          EthCtrlConfigSpiTransmitCreditThreshold = 0
          EthCtrlConfigSpiAccessSynchronous = FALSE
          EthCtrlConfigSpiSequenceName = SEQ_ETHERNET_BASIC_TX_RX
    EthGeneral:
      EthIndex = 0
      EthDevErrorDetect = FALSE
      EthMainFunctionPeriod = 0.1
      EthGetCounterValuesApi = FALSE
      EthGetRxStatsApi = FALSE
      EthGetTxErrorCounterValuesApi = FALSE
      EthGetTxStatsApi = FALSE
      EthGlobalTimeSupport = FALSE
      EthMaxCtrlsSupported = 1
      EthVersionInfoApi = FALSE
      EthCtrlOffloading:
        EthCtrlEnableOffloadChecksumIPv4 = FALSE
        EthCtrlEnableOffloadChecksumICMP = FALSE
        EthCtrlEnableOffloadChecksumTCP = FALSE
        EthCtrlEnableOffloadChecksumUDP = FALSE
